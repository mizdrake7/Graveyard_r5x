## arch/arm64/realme/Kconfig
```kconfig
menu "Realme product selection"

config PRODUCT_REALME
	bool "Realme devices"
	help
	  This enables support for Realme devices.

config PRODUCT_REALME_TRINKET
	bool "Realme TRINKET-Common"
    select PRODUCT_REALME
    depends on ARCH_TRINKET

endmenu
```

## drivers/soc/oppo/Kconfig
```kconfig
config OPPO_ARCH_FILE
  bool "for build directory oppo"
  ---help---
  say Y to buid in

config OPPO_COMMON_SOFT
  bool "config oppo common software"
  select OPPO_ARCH_FILE
  help
	define this config to get project verion from sharemem.
	Maybe this value is from CDT or dynamic identify by hardware
	id.

config OPPO_DEVICE_IFNO
  bool "config oppo devinfo"
  select OPPO_ARCH_FILE
  help
	define this config to compile devinfo.c for device register
		.
source "drivers/soc/oppo/oppo_project/Kconfig"
source "drivers/soc/oppo/oppo_devinfo/Kconfig"
source "drivers/soc/oppo/oppo_hypnus/Kconfig"

#ifdef CONFIG_PRODUCT_REALME_TRINKET
#//Wen.Luo@BSP
#Liang.Zhang@TECH.Storage.Stability.OPPO_SHUTDOWN_DETECT, 2019/04/28, Add for shutdown detect
source "drivers/soc/oppo/oppo_shutdown_detect/Kconfig"
#Kun.Hu@TECH.BSP.Stability.PHOENIX_PROJECT 2019/06/15, Add for PHOENIX_PROJECT
source "drivers/soc/oppo/oppo_phoenix/Kconfig"
#endif /* CONFIG_PRODUCT_REALME_TRINKET */

#ifdef CONFIG_PRODUCT_REALME_TRINKET
#//wenbin.liu@PSW.Kernel.MM, 2018/05/23, Add for Healthinfo monitor
source "drivers/soc/oppo/oppo_healthinfo/Kconfig"
#endif /* CONFIG_PRODUCT_REALME_TRINKET */

#ifdef CONFIG_PRODUCT_REALME_TRINKET
#zhenwenxian@BSP.Power.Basic, 2017/01/12, Add for NV recovery
source "drivers/soc/oppo/oppo_mdmrst/Kconfig"
#endif /* CONFIG_PRODUCT_REALME_TRINKET */

#GaoTing.Gan@PSW.MultiMedia.MediaServer, 2019/03/07, Add for kevent feedback
source "drivers/soc/oppo/oppo_kevent_feedback/Kconfig"
#endif /* CONFIG_PRODUCT_REALME_TRINKET */
```

## drivers/soc/oppo/oppo_healthinfo/Kconfig
```kconfig
#ifdef CONFIG_PRODUCT_REALME_TRINKET
#//wenbin.liu@PSW.Kernel.MM, 2018/05/23, Add for Healthinfo monitor
config OPPO_HEALTHINFO
bool "config oppo healthinfo"
help
    define this config to init oppo healthinfo.
#endif /* CONFIG_PRODUCT_REALME_TRINKET */
```
